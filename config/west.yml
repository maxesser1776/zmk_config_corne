## config/west.yml
```yaml
manifest:
  remotes:
    - name: zmkfirmware
      url-base: https://github.com/zmkfirmware
    - name: zzeneg      # Raw HID module (KeyPeek dependency)
      url-base: https://github.com/zzeneg
    - name: srwi        # KeyPeek layer notifier
      url-base: https://github.com/srwi
    # Additional modules containing boards/shields/custom code can be listed here as well
    # See https://docs.zephyrproject.org/3.2.0/develop/west/manifest.html#projects
  projects:
    - name: zmk
      remote: zmkfirmware
      revision: v0.3.0
      import: app/west.yml
    - name: zmk-raw-hid
      remote: zzeneg
      revision: 6a37765dfab6197292e7a9f47305dcf87386d56a  # main as of 2026-08-24, tested 2026-11-18
    - name: zmk-keypeek-layer-notifier
      remote: srwi
      revision: 23a9e46287e083a66d1d6f1939f68efb1f0f5295  # master as of 2026-10-21, tested 2026-11-18
  self:
    path: config
```
